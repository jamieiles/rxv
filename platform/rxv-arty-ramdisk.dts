// SPDX-License-Identifier: GPL-2.0+
/dts-v1/;

/include/ "rxv-arty.dts"

/ {
    chosen {
        bootargs = "console=ttyS0,115200 earlycon phram.phram=rootfs,0x88000000,64Mi root=/dev/mtdblock0 rw panic_on_warn=1 systemd.unit=multi-user.target";
    };

    reserved-memory {
        #address-cells = <1>;
        #size-cells = <1>;
        ranges;

        // The root filesystem image, preloaded for phram.
        rootfs@88000000 {
            reg = <0x88000000 0x4000000>;
            no-map;
        };
    };
};
